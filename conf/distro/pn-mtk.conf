## conf/distro/pn-mtk.conf
```bitbake
# SPDX-License-Identifier: MIT
#
# Pyxis distro configuration for MediaTek Genio platforms.

DISTRO = "pn-mtk"
DISTRO_NAME = "Pyxis MediaTek Genio"
DISTRO_VERSION = "1.0"
SDK_VENDOR = "-pyxis"
SDK_VERSION = "${DISTRO_VERSION}"

MAINTAINER = "Pyxis (pyxis.ai)"

PACKAGE_CLASSES ?= "package_rpm"

VIRTUAL-RUNTIME_init_manager ?= "systemd"
VIRTUAL-RUNTIME_initscripts ?= ""
DISTRO_FEATURES_BACKFILL_CONSIDERED:append = " sysvinit"
DISTRO_FEATURES:append = " wayland opengl pam pulseaudio bluetooth wifi gstreamer"

EXTRA_IMAGE_FEATURES ?= "debug-tweaks ssh-server-openssh package-management"
IMAGE_LINGUAS ?= "en-us"

# Allow H.264/H.265 where licensing requires explicit acceptance.
LICENSE_FLAGS_ACCEPTED:append = " commercial"

PREFERRED_PROVIDER_virtual/egl ?= "mesa"
PREFERRED_PROVIDER_virtual/libgl ?= "mesa"
PREFERRED_PROVIDER_virtual/mesa ?= "mesa"

# Chromium defaults for Wayland/VAAPI/WebRTC usage.
PYXIS_CHROMIUM_FLAGS ?= "--enable-features=VaapiVideoDecoder,UseOzonePlatform --ozone-platform=wayland --ignore-gpu-blocklist"
```

## conf/layer.conf
```bitbake
# SPDX-License-Identifier: MIT
#
# Base configuration for the meta-pyxis-mtk layer.

BBPATH .= ":${LAYERDIR}"

BBFILES += "${LAYERDIR}/recipes-*/*/*.bb \
            ${LAYERDIR}/recipes-*/*/*.bbappend \
            ${LAYERDIR}/recipes-*/*/*/*.bb \
            ${LAYERDIR}/recipes-*/*/*/*.bbappend"

BBFILE_COLLECTIONS += "meta-pyxis-mtk"
BBFILE_PATTERN_meta-pyxis-mtk = "^${LAYERDIR}/"
BBFILE_PRIORITY_meta-pyxis-mtk = "6"

LAYERSERIES_COMPAT_meta-pyxis-mtk = "scarthgap"

# Dependencies: poky core, meta-openembedded (openembedded-layer), and
# meta-browser for Chromium (browser-layer). MediaTek BSP layer must also
# be present to provide the Genio 350 EVK machine configuration.
LAYERDEPENDS_meta-pyxis-mtk = "core openembedded-layer browser-layer"

# Convenience variables used by recipes in this layer.
PYXIS_MTK_SOC_FAMILY ?= "genio350"
PYXIS_MTK_MACHINE ?= "genio350-evk"
```
